# file: STM32_LED.ioc
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Mcu.Family=STM32F1
Mcu.Name=STM32F103C(8-B)Tx
Mcu.Package=LQFP48
NVIC.PriorityGroup=NVIC_PRIORITYGROUP_4
PA0-WKUP.GPIO_Label=LED0
PA0-WKUP.Signal=GPIO_Output
PA13.Mode=Serial_Wire
PA13.Signal=SYS_JTMS-SWDIO
PA14.Mode=Serial_Wire
PA14.Signal=SYS_JTCK-SWCLK
ProjectManager.HeapSize=0x200
ProjectManager.StackSize=0x400
ProjectManager.TargetToolchain=Makefile
RCC.APB1Freq_Value=8000000
RCC.APB2Freq_Value=8000000
board=custom

// file: Core/Src/main.c
/* USER CODE BEGIN Header */
/**
  ******************************************************************************
  * @file           : main.c
  * @brief          : Main program body
  ******************************************************************************
  * @attention
  *
  * Copyright (c) 2024 STMicroelectronics.
  * All rights reserved.
  *
  * This software is licensed under terms that can be found in the LICENSE file
  * in the root directory of this software component.
  * If no LICENSE file comes with this software, it is provided AS-IS.
  *
  ******************************************************************************
  */
/* USER CODE END Header */
#include "main.h"
// #include "gpio.h"
// #include "key.h"
// #include "buzzer.h"
// #include "LightSensor.h"
#include "OLED.h"
#include"CountSensor.h"
#include "stm32f1xx_hal.h"

void SystemClock_Config(void);

int main(void)
{

  /* MCU Configuration--------------------------------------------------------*/

  /* Reset of all peripherals, Initializes the Flash interface and the Systick. */
  HAL_Init();

  /* Configure the system clock */
  SystemClock_Config();

  /* Initialize all configured peripherals */
  // MX_GPIO_Init();

  /* USER CODE BEGIN 2 */
  // Key_Init();
  // BUZZER_Init();
  // LightSensor_Init();
  CountSensor_Init();
  OLED_Init();

  //确实显示不好入死循环
  //实际上和好不好进入while(1)循环无关，只关系到刷新问题

  //LED显示
  OLED_ShowString(1,1,"Count:");
  // OLED_ShowString(1,3,"HELLO WORLD!");//一行三列开始显示
  // OLED_ShowNum(2,1,12345,5);
  // OLED_ShowSignedNum(2,7,-66,2);//2行7列显示十进制-66，长度为2
  // OLED_ShowHexNum(3,1,0xAA55,4);
  // OLED_ShowBinNum(4,1,0xAA55,16);//c语言无法直接写出二进制数字，所以需要16进制来表示

  /* USER CODE END 2 */

  /* Infinite loop */
  /* USER CODE BEGIN WHILE */
  while (1)
  {
    // /* USER CODE END WHILE */
    OLED_ShowNum(1,7,CountSensor_Get(),5);

    /*
    小灯的控制程序
    */
    // // HAL_Delay(500);
    // if(HAL_GPIO_ReadPin(GPIOB,KEY0_Pin)==GPIO_PIN_RESET)
    // {
    //   HAL_Delay(20);
    //   while (HAL_GPIO_ReadPin(GPIOB,KEY0_Pin)==GPIO_PIN_RESET){
    //     HAL_Delay(20);
    //     }
    //     LED0_Toggle();
    //     //  {/* code */
    //   //   HAL_Delay(20);
    //   //   LED0_Toggle();
    //   //  }不该将toggle包含在循环里，会导致不断20ms交换状态
    //   /* code */

    // }

    // if(HAL_GPIO_ReadPin(GPIOB,KEY1_Pin)==GPIO_PIN_RESET)
    // {
    //   HAL_Delay(20);
    //   while (HAL_GPIO_ReadPin(GPIOB,KEY1_Pin)==GPIO_PIN_RESET){
    //     /* code */
    //     HAL_Delay(20);
    //   }
    //     LED1_Toggle();
    // }

    // if (LightSensor_get()==GPIO_PIN_RESET)
    // {
    //   /* code */
    //   BUZZER_ON();
    // }
    // if (LightSensor_get()==GPIO_PIN_SET)
    // {
    //   /* code */
    //   BUZZER_OFF();
    // }

    }

    // LED0_Toggle();
    // LED1_Toggle();

}

void SystemClock_Config(void)
{
  RCC_OscInitTypeDef RCC_OscInitStruct = {0};
  RCC_ClkInitTypeDef RCC_ClkInitStruct = {0};

  /** Initializes the RCC Oscillators according to the specified parameters
  * in the RCC_OscInitTypeDef structure.
  */
  RCC_OscInitStruct.OscillatorType = RCC_OSCILLATORTYPE_HSI;
  RCC_OscInitStruct.HSIState = RCC_HSI_ON;
  RCC_OscInitStruct.HSICalibrationValue = RCC_HSICALIBRATION_DEFAULT;
  RCC_OscInitStruct.PLL.PLLState = RCC_PLL_NONE;
  if (HAL_RCC_OscConfig(&RCC_OscInitStruct) != HAL_OK)
  {
    Error_Handler();
  }

  /** Initializes the CPU, AHB and APB buses clocks
  */
  RCC_ClkInitStruct.ClockType = RCC_CLOCKTYPE_HCLK|RCC_CLOCKTYPE_SYSCLK
                              |RCC_CLOCKTYPE_PCLK1|RCC_CLOCKTYPE_PCLK2;
  RCC_ClkInitStruct.SYSCLKSource = RCC_SYSCLKSOURCE_HSI;
  RCC_ClkInitStruct.AHBCLKDivider = RCC_SYSCLK_DIV1;
  RCC_ClkInitStruct.APB1CLKDivider = RCC_HCLK_DIV1;
  RCC_ClkInitStruct.APB2CLKDivider = RCC_HCLK_DIV1;

  if (HAL_RCC_ClockConfig(&RCC_ClkInitStruct, FLASH_LATENCY_0) != HAL_OK)
  {
    Error_Handler();
  }
}

void Error_Handler(void)
{
  __disable_irq();
  while (1)
  {
  }
}
